// T32 Wed Aug 09 15:12:43 2006

 B::
 
 TOOLBAR ON
 STATUSBAR ON
 WINPAGE.RESET
 
 WINCLEAR
 WINPOS 99.625 0.5625 23. 4. 0. 0. W001
 Var.Watch %E %SPOTLIGHT DECctr 
 
 
 WINPOS 1.625 13.625 77. 20. 0. 0. W003
 r /spotlight
 
 WINPOS 0.0 0.125 95. 9. 13. 1. W001
 WINTABS 10. 10. 25. 62.
 Data.List                 
 
 WINPAGE.SELECT P000     
 
 ENDDO
